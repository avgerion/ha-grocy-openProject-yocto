## yocto/conf/bblayers.conf.sample
```bitbake
# Example bblayers.conf skeleton
# Replace <YOCTO_ROOT> with your path.

BBLAYERS ?= " \
  <YOCTO_ROOT>/poky/meta \
  <YOCTO_ROOT>/poky/meta-poky \
  <YOCTO_ROOT>/poky/meta-yocto-bsp \
  <YOCTO_ROOT>/meta-openembedded/meta-oe \
  <YOCTO_ROOT>/meta-openembedded/meta-python \
  <YOCTO_ROOT>/meta-openembedded/meta-networking \
  <YOCTO_ROOT>/meta-raspberrypi \
  <YOCTO_ROOT>/meta-virtualization \
  <YOCTO_ROOT>/ha-grocy-openProject-yocto/yocto/layers/meta-ha-grocy-openproject \
"
```

## yocto/conf/local.conf.sample
```bitbake
# Example local.conf for Raspberry Pi
# Raspberry Pi 4 (64-bit): raspberrypi4-64
# Raspberry Pi 3 (64-bit): raspberrypi3-64
MACHINE ??= "raspberrypi4-64"

DISTRO_FEATURES:append = " systemd virtualization"
VIRTUAL-RUNTIME_init_manager = "systemd"

# Docker runtime compatibility
KERNEL_FEATURES:append = " features/overlayfs/overlayfs.scc"

ENABLE_UART = "1"
EXTRA_IMAGE_FEATURES ?= "ssh-server-openssh"

# Set package format as needed
PACKAGE_CLASSES ?= "package_rpm"
```
